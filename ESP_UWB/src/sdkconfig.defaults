## ESP_UWB/src/sdkconfig.defaults
```kconfig
CONFIG_IDF_TARGET="esp32s3"
CONFIG_ESPTOOLPY_FLASHSIZE_4MB=y
CONFIG_ESP_CONSOLE_USB_SERIAL_JTAG=y

# DW3000 / DW3120 UWB module wiring
CONFIG_DW3000_CHIP_DW3000=y
CONFIG_DW3000_SPI_CLK=10
CONFIG_DW3000_SPI_MISO=11
CONFIG_DW3000_SPI_MOSI=12
CONFIG_DW3000_SPI_CS=13
CONFIG_DW3000_GPIO_RESET=4
CONFIG_DW3000_GPIO_IRQ=5
CONFIG_DW3000_GPIO_WAKEUP=-1
```
